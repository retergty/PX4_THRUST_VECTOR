## src/drivers/joican/Kconfig
```kconfig
menuconfig DRIVERS_JOICAN
	bool "jointcan"
	default n
    depends on PLATFORM_NUTTX
	---help---
		Enable support for damiao jointcan
```

## src/drivers/serial_test/Kconfig
```kconfig
menuconfig DRIVERS_SERIAL_TEST
	bool "serial_test"
	default n
	---help---
		Enable support for serial_test
```

## src/modules/thrust_vector_pos_control/Kconfig
```kconfig
menuconfig MODULES_THRUST_VECTOR_POS_CONTROL
	bool "thrust_vector_mc_pos_control"
	default n
	---help---
		Enable support for thrust_vector_pos_control

menuconfig USER_THRUST_VECTOR_POS_CONTROL
	bool "thrust_vector_pos_control running as userspace module"
	default y
	depends on BOARD_PROTECTED && MODULES_THRUST_VECTOR_CONTROL
	---help---
		Put thrust_vector_pos_control in userspace memory
```
